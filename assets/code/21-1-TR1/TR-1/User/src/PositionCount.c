#include "PositionCount.h"

/*****************************************************************/
float x_del;				   	//定位坐标X增量
float y_del;				   	//定位坐·标Y增量
float a_del;            //定位坐标角度增量
float Gyro_angle_delta = 0;
extern int ANGLE_FLAG;

POSITION Position_Now	= 	{-0.1829103,-4.943582,0,0,0};       //码盘坐标(cm)
POSITION Position 	  	= 	{0,0,0,0,0,0};	       //大车坐标
POSITION Position_Last 	= 	{0,0,0,0,0,0};	       //大车上一次解算坐标
SPEED Speed_Now 	 	= 	{0,0,0,0};
SPEED Speed_temp 	  	= 	{0,0,0,0};

int    zp_now_position = 0;//零点目前所在位置
double zp_sum = 0;
double zp_data[MAX_ZP_SAMPLE] = {0};
double angle=0;
double filted_rate=0;
u8 	   init_flag =0;
/****************************标定参数*************************************/
float POS_SCALE = 3359.21005159662;					/* VG103 陀螺仪正向转的积分系数*/
float NEG_SCALE	= 3359.21005159662;

float POS_CM_PER_CNT_1 = 0.004019411;
float POS_CM_PER_CNT_2 = 0.00400647;
float NEG_CM_PER_CNT_1 = 0.004021005;
float NEG_CM_PER_CNT_2 = 0.004005201;
float CM_PER_CNT_1 = 0.004019411;
float CM_PER_CNT_2 = 0.00400647;

float OO_distance	=	 4.9469645;//4.955732;//4.891343;								//底盘中心到码盘中心的距离（cm）
float Angle_XX 		=	0.784296619;									//弧度制（β）	 
float Angle_OO 		= 	-1.607779;//-1.591452;//-1.570796;			            //弧度制（α）   

float mp_angle_wrong = 0.004457517;//0.004374746;//0.00436968860244446						//弧度

float SCALE_TAB[1401] = {
3359.21005159662,
3359.21626141401,
3359.22247123139,
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3452.35278450999,
};

/*****************************标定过程参数************************************/
//float msg_Angle_OO = 0;			 		//圆弧更新标定α
//float msg_OO_distance = 0;			//圆弧更新标定L

//float K1,K2,arc_K1,arc_K2;
//float angle_delta_max = 0;
/*****************************中间变量****************************************/
float course_sum_1 = 0; 
float course_sum_2 = 0;

float time = 0, time_last = 0, time_det = 0;
float speed_Vnow = 0,speed_Vlast = 0;
float Accelerated_Speed;
extern double Angular_Velocity;
/*****************************************************************/

void CountAngel(void)	//运行 146.25us
{
	if(comb_flt.comb_filter_flag == 2)							    //5us 执行时间IIR_input
	{
		kal_input	 = Angular_Velocity;
		kal_output = kalman_filter(&kal_filter,kal_input);				  //卡尔曼滤波,	加了一阶滞后滤波
		second_order_exkalman_output=second_order_exkalman_filter(&EXkal_filter,&second_order_flt,kal_input);//Angular_Velocity;//second_order_exkalman_filter(&EXkal_filter,&second_order_flt,kal_input);
		if(init_flag == 0)			//开机时先采集MAX_ZP_SAMPLE个数据，用于零点的更新
		{
			if(zp_now_position<(MAX_ZP_SAMPLE-1))
			{
				LED_RED_ON();
				LED_GREEN_OFF();
				zp_data[zp_now_position] = kal_output;
				zp_sum += zp_data[zp_now_position++];
			}
			else		/*初始化数完毕 init_flag置1*/
			{
				LED_RED_OFF();
				init_flag = 1;
				zp_data[zp_now_position] = kal_output;
				zp_sum  += zp_data[zp_now_position];
				kal_filter.zero_point = (float)(zp_sum/(MAX_ZP_SAMPLE));    /*初始化完成,零点第一次被更新 -- 取平均值，用卡尔曼滤波取静态的零点*/
			}
		}				
		else  	//首次零点更新完成
		{			
			cha = fabs(kal_output-kal_filter.zero_point);

			if( cha < ZERO_THREDHOLD)       //阈值内的值用于更新零点
			{
				if(zp_now_position<MAX_ZP_SAMPLE)
				{
					zp_sum -= zp_data[zp_now_position];
					zp_data[zp_now_position] = kal_output;
					zp_sum += zp_data[zp_now_position];
					kal_filter.zero_point = (float)(zp_sum/(MAX_ZP_SAMPLE));
					zp_now_position++;
				}				
				else
				{
					zp_now_position = 0;
					zp_sum = zp_sum-zp_data[zp_now_position];
					zp_data[zp_now_position] = kal_output ;
					zp_sum += zp_data[zp_now_position];
					kal_filter.zero_point =(float)(zp_sum/(MAX_ZP_SAMPLE));
					zp_now_position++;
				}			
			}
			else/*阈值外的值用于积分*/
			{	
				filted_rate = -(double)((second_order_exkalman_output- kal_filter.zero_point))*SAMP_TIME;		
				if(filted_rate > 0)	//正角速度
				{
				  POS_SCALE = 0.9997237 * SCALE_TAB[(int)(filted_rate * 10)];
					Gyro_angle_delta += filted_rate/(POS_SCALE);	
				}
				else  //负角速度
				{
					NEG_SCALE = 0.9995306 * SCALE_TAB[(int)(-filted_rate * 10)];
					Gyro_angle_delta += filted_rate/(NEG_SCALE);
				}
			}
		}
		ANGLE_FLAG++;
	}
}

void CountPosition(void)	//运行 135.59us
{	
	float Angle_delta;      													//姿态角增量
	float Angle1,Angle2;
	float Angle1_del,Angle2_del;												//用于寄存公用的三角函数运算值，减少重复计算
	float Angle1_cos,Angle1_sin,Angle2_cos,Angle2_sin;
	float Angle1_del_cos,Angle1_del_sin,Angle2_del_cos,Angle2_del_sin;
	float course_delta_1 = 0,course_delta_2 = 0 ;								//码盘1,2的距离增量	
	float AngleDeg_HuDu;														//姿态角
	AngleDeg_HuDu = Position_Now.AngleDeg * PI / 180;				//上一次的弧度 -- 角度变弧度
	Angle_delta = Gyro_angle_delta * PI / 180;					//变化的弧度 -- 角度变弧度
///*****************************仅计算阈值****************************************/
//	if(Gyro_angle_delta > angle_delta_max)
//			angle_delta_max = Gyro_angle_delta;	
///*****************************计算出来就删除****************************************/
	Position_Now.AngleDeg += Gyro_angle_delta;									//增量式更新姿态角
	a_del += Gyro_angle_delta;  
	Gyro_angle_delta = 0;  

	Encoder_Get_CNT();	//获取码盘 1 和码盘 2 的脉冲数
	
	if(DeltaCntEncoder1 > 0)
		CM_PER_CNT_1 = POS_CM_PER_CNT_1;	//转换为码盘 1 走过的路程
	else
		CM_PER_CNT_1 = NEG_CM_PER_CNT_1;	//转换为码盘 1 走过的路程
	if(DeltaCntEncoder2 > 0)
		CM_PER_CNT_2 = POS_CM_PER_CNT_2;	//转换为码盘 1 走过的路程
	else
		CM_PER_CNT_2 = NEG_CM_PER_CNT_2;	//转换为码盘 1 走过的路程
	
	course_delta_1 = CM_PER_CNT_1 * ((float)(DeltaCntEncoder1));	//转换为码盘 1 走过的路程
	course_delta_2 = CM_PER_CNT_2 * ((float)(DeltaCntEncoder2));	//转换为码盘 1 走过的路程
	course_sum_1 = CM_PER_CNT_1 * ((float)(Position_Now.Sum_Encoder1));
	course_sum_2 = CM_PER_CNT_2 * ((float)(Position_Now.Sum_Encoder2));
	
	Position_Now.Sum_Encoder1	+= DeltaCntEncoder1;			//增量式更新码盘 1 走过的总路程
	Position_Now.Sum_Encoder2	+= DeltaCntEncoder2;			//增量式更新码盘 2 走过的总路程
		
	Angle1 = Angle_XX + AngleDeg_HuDu;
	Angle1_cos = cos(Angle1);
	Angle1_sin = sin(Angle1);
	Angle2 = Angle_XX + AngleDeg_HuDu + mp_angle_wrong;
	Angle2_sin = sin(Angle2);
	Angle2_cos = cos(Angle2);	
	
	if(fabs(Angle_delta) < 0.0006) //直线更新,仅平动
	{
		x_del += course_delta_1*Angle1_cos - course_delta_2*Angle2_sin;
		y_del += course_delta_1*Angle1_sin + course_delta_2*Angle2_cos;
	}
	else
	{		
		Angle1_del = Angle1 + Angle_delta;
		Angle2_del = Angle2 + Angle_delta;
		Angle1_del_sin = sin(Angle1_del);
		Angle1_del_cos = cos(Angle1_del);
		Angle2_del_sin = sin(Angle2_del);
		Angle2_del_cos = cos(Angle2_del);
		
		x_del += (course_delta_1 * (Angle1_del_sin - Angle1_sin) + course_delta_2 * (Angle2_del_cos - Angle2_cos)) / (2 * sin(Angle_delta/2));	
		y_del += (-course_delta_1 * (Angle1_del_cos - Angle1_cos) + course_delta_2 * (Angle2_del_sin - Angle2_sin)) / (2 * sin(Angle_delta/2));
	
//		arc_K1 += (course_delta_1 * (Angle1_del_sin - Angle1_sin) + course_delta_2 * (Angle2_del_cos - Angle2_cos)) / (2 * sin(Angle_delta/2));
//		arc_K2 += (-course_delta_1 * (Angle1_del_cos - Angle1_cos) + course_delta_2 * (Angle2_del_sin - Angle2_sin)) / (2 * sin(Angle_delta/2));		
		
	}      
//	K1 = arc_K1 - (-0.050942);
//	K2 = arc_K2 - (-98.32000);
//	
//	msg_Angle_OO = atan(K2/K1);
//	msg_OO_distance = sqrt(K1*K1 + K2*K2)/2; 	
}
	

void CountSpeed(void)	//第一个速度值不要
{	
	float X_del,Y_del;
	float temp,temp_sin,temp_cos,ticks;	//用于寄存公用的三角函数运算值，减少重复计算	
	
	ticks = OSTimeGet();
	time = (float)ticks/10000.0f;    //tick_ms强制转化为float类型
	time_det = time - time_last;
	time_last = time;	
	
	Position_Now.X += x_del;
	Position_Now.Y += y_del; 

	temp = (Position_Now.AngleDeg)*PI/180+Angle_OO;
	temp_cos = cos(temp);
	temp_sin = sin(temp);
	
	Position_Last.X = Position.X;
	Position_Last.Y = Position.Y;
	Position.X = Position_Now.X - OO_distance*temp_cos;					//车的位置x坐标
	Position.Y = Position_Now.Y - OO_distance*temp_sin;					//车的位置y坐标
	Position.AngleDeg = Position_Now.AngleDeg;							//1ms 更新一次坐标
	
	X_del = Position.X - Position_Last.X;								//小车坐标增量
	Y_del = Position.Y - Position_Last.Y;
	
	Speed_Now.Vx = KAL_filter(&kalman_Vx,(double)(X_del/time_det));
	Speed_Now.Vy = KAL_filter(&kalman_Vy,(double)(Y_del/time_det));
	Speed_Now.Vw = KAL_filter(&kalman_Vw,(double)(a_del/time_det));
	Speed_Now.V = sqrt(Speed_Now.Vx*Speed_Now.Vx + Speed_Now.Vy*Speed_Now.Vy);
	Accelerated_Speed = KAL_filter(&kalman_Accelerate,(double)((speed_Vnow-speed_Vlast)/time_det));
  
	speed_Vlast = speed_Vnow;
	speed_Vnow = Speed_Now.V;
	
	x_del = 0;
	y_del = 0;
	a_del = 0;
}

void GYRO_Reset(void)
{
   __set_FAULTMASK(1); /*把FAULTMASK置位，即关闭所有的中断执行复位时不被中断打断*/
   NVIC_SystemReset();/*系统软件复位，配置好的外设寄存器也一起复位*/
}




